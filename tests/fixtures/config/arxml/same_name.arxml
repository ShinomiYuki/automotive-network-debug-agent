AUTOSAR XML (schema 4.0)
package /Other
  pdu IPdu_500_SU: length=8
  pdu IPdu_500_Other: length=8
  PduRRoutingPath_500_Other (PduRRoutingPath)
    PduRSrcPdu_500_Other (PduRSrcPdu): PduRSrcPduRef=/Other/IPdu_500_SU
    PduRDestPdu_500_Other (PduRDestPdu): PduRDestPduRef=/Other/IPdu_500_Other
