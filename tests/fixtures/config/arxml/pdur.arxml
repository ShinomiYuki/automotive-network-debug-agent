AUTOSAR XML (schema 4.0)
package /Config
  module config PduR
    3 x PduRRoutingPath:
      PduRRoutingPath_416_SU
        PduRSrcPdu_416_SU (PduRSrcPdu): PduRSrcPduRef=IPdu_416_SU
        PduRDestPdu_416_IC (PduRDestPdu): PduRDestPduRef=IPdu_416_IC
        PduRDestPdu_416_GL (PduRDestPdu): PduRDestPduRef=IPdu_416_GL
      PduRRoutingPath_500_SU
        PduRSrcPdu_500_SU (PduRSrcPdu): PduRSrcPduRef=/Network/IPdu_500_SU
        PduRDestPdu_500_IC (PduRDestPdu): PduRDestPduRef=/Network/IPdu_500_IC
      PduRRoutingPath_600_SU
        PduRSrcPdu_600_SU (PduRSrcPdu): PduRSrcPduRef=/Network/IPdu_600_SU
