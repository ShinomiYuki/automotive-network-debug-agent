AUTOSAR XML (schema 4.0)
package /Network
  pdu IPdu_416_IC: length=8
  pdu IPdu_416_GL: length=8
  pdu IPdu_500_IC: length=8
  can cluster GatewayCanCluster
    can physical channel SU
      frame CanFrame_416: id 0x416, frame-length=8
        pdu IPdu_416_SU: length=8
      frame CanFrame_500: id 0x500, frame-length=8
        pdu IPdu_500_SU: length=8
      frame CanFrame_600: id 0x600, frame-length=8
        pdu IPdu_600_SU: length=8
      frame CanFrame_700: id 0x700, frame-length=8
        pdu IPdu_700_SU: length=8
    can physical channel IC
      pdu triggering IPdu_416_IC_Trigger: pdu=IPdu_416_IC
      pdu triggering IPdu_500_IC_Trigger: pdu=IPdu_500_IC
    can physical channel GL
      pdu triggering IPdu_416_GL_Trigger: pdu=IPdu_416_GL
