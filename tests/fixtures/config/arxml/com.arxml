AUTOSAR XML (schema 4.0)
package /ActiveEcuC
  module config Com
    RxGroup (ComIPduGroup): ComIPduGroupHandleId=1
    TxGroup (ComIPduGroup): ComIPduGroupHandleId=2
    VehicleSpeed_Rx (ComSignal): ComBitPosition=8, ComBitSize=16, ComSignalInitValue=0, ComRxDataTimeoutAction=REPLACE, ComRxDataTimeoutSubstitutionValue=65535, ComTimeout=0.5
    VehicleSpeed_Tx (ComSignal): ComBitPosition=0, ComTransferProperty=TRIGGERED_ON_CHANGE
    ComPdu_534_Rx (ComIPdu):
      ComIPduDirection = RECEIVE
      ComIPduGroupRef = /ActiveEcuC/Com/RxGroup
      ComIPduSignalRef = /ActiveEcuC/Com/VehicleSpeed_Rx
      ComPduIdRef = /ActiveEcuC/EcuC/Pdu_534_Rx
    ComPdu_534_Tx (ComIPdu):
      ComIPduDirection = SEND
      ComIPduGroupRef = /ActiveEcuC/Com/TxGroup
      ComIPduSignalRef = /ActiveEcuC/Com/VehicleSpeed_Tx
      ComPduIdRef = /ActiveEcuC/EcuC/Pdu_534_Tx
      ComTxIPdu: ComMinimumDelayTime=0.005
        ComTxModeTrue
          ComTxMode: ComTxModeMode=PERIODIC, ComTxModeTimePeriod=0.02
    VehicleSpeed_GW (ComGwMapping)
      ComGwSource
        ComGwSignal: ComGwSignalRef=/ActiveEcuC/Com/VehicleSpeed_Rx
      ComGwDestination
        ComGwSignal: ComGwSignalRef=/ActiveEcuC/Com/VehicleSpeed_Tx
    Start_TxGroup (BswMComPduGroupSwitch): BswMComPduGroupSwitchAction=START, BswMComPduGroupSwitchIPduGroupRef=/ActiveEcuC/Com/TxGroup
    ComM_TxGroup_Link (ComMChannel): ComMIPduGroupRef=/ActiveEcuC/Com/TxGroup
