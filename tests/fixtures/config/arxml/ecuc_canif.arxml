AUTOSAR XML (schema 4.0)
package /ActiveEcuC
  module config CanIf
    Controller_BD (CanIfCtrlCfg)  # Network_BD
    Controller_IC (CanIfCtrlCfg)  # Network_IC
    Hrh_BD (CanIfHrhCfg): CanIfHrhCanCtrlIdRef=/ActiveEcuC/CanIf/Controller_BD
    Hth_IC (CanIfHthCfg): CanIfHthCanCtrlIdRef=/ActiveEcuC/CanIf/Controller_IC
    Buffer_IC (CanIfBufferCfg): CanIfBufferHthRef=/ActiveEcuC/CanIf/Hth_IC
    Message_534_Rx (CanIfRxPduCfg):
      CanIfRxPduCanId = 1332
      CanIfRxPduCanIdType = STANDARD_CAN_FD
      CanIfRxPduDlc = 16
      CanIfRxPduHrhIdRef = /ActiveEcuC/CanIf/Hrh_BD
      CanIfRxPduRef = /ActiveEcuC/EcuC/Pdu_534_Rx
    Message_534_Tx (CanIfTxPduCfg):
      CanIfTxPduCanId = 1332
      CanIfTxPduCanIdType = STANDARD_CAN_FD
      CanIfTxPduDlc = 16
      CanIfTxPduBufferRef = /ActiveEcuC/CanIf/Buffer_IC
      CanIfTxPduRef = /ActiveEcuC/EcuC/Pdu_534_Tx
    Route_534 (PduRRoutingPath)
      Source_534 (PduRSrcPdu): PduRSrcPduPduRBswModulesRef=/ActiveEcuC/PduR/CanIf, PduRSrcPduRef=/ActiveEcuC/EcuC/Pdu_534_Rx
      Destination_534 (PduRDestPdu): PduRDestPduPduRBswModulesRef=/ActiveEcuC/PduR/CanIf, PduRDestPduRef=/ActiveEcuC/EcuC/Pdu_534_Tx
